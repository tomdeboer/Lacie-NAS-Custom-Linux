## board/configs/d2net_defconfig
```kconfig
BR2_arm=y
BR2_DL_DIR="$(BASE_DIR)/downloads"
BR2_CCACHE=y
BR2_CCACHE_DIR="$(BASE_DIR)/ccache"
BR2_KERNEL_HEADERS_4_4=y
BR2_TARGET_GENERIC_HOSTNAME="d2netv2"
BR2_TARGET_GENERIC_ISSUE="Welcome to Lacie D2 Network V2 NAS system"
BR2_ROOTFS_MERGED_USR=y
BR2_TARGET_GENERIC_ROOT_PASSWD="root"
BR2_SYSTEM_DHCP="eth0"
BR2_TARGET_TZ_INFO=y
BR2_TARGET_LOCALTIME="Europe/Amsterdam"
BR2_ROOTFS_OVERLAY="$(BR2_EXTERNAL)/rootoverlay"
BR2_LINUX_KERNEL=y
BR2_LINUX_KERNEL_USE_CUSTOM_CONFIG=y
BR2_LINUX_KERNEL_CUSTOM_CONFIG_FILE="$(BR2_EXTERNAL)/linux.config"
BR2_LINUX_KERNEL_UIMAGE_LOADADDR="2000000"
BR2_LINUX_KERNEL_DTS_SUPPORT=y
BR2_LINUX_KERNEL_INTREE_DTS_NAME="kirkwood-d2net"
BR2_PACKAGE_LIBSELINUX=y
BR2_TARGET_ROOTFS_TAR_GZIP=y
```

## buildroot/configs/d2net_defconfig
```kconfig
BR2_arm=y
BR2_DL_DIR="$(BASE_DIR)/downloads"
BR2_CCACHE=y
BR2_CCACHE_DIR="$(BASE_DIR)/ccache"
BR2_KERNEL_HEADERS_4_4=y
BR2_TOOLCHAIN_BUILDROOT_INET_RPC=y
BR2_TOOLCHAIN_BUILDROOT_LOCALE=y
BR2_BINUTILS_VERSION_2_26_X=y
BR2_TOOLCHAIN_BUILDROOT_CXX=y
BR2_ENABLE_LOCALE_PURGE=y
BR2_ENABLE_LOCALE_WHITELIST="C en_GB"
BR2_GENERATE_LOCALE="en_GB"
BR2_TARGET_GENERIC_HOSTNAME="d2netv2"
BR2_TARGET_GENERIC_ISSUE="Welcome to Lacie D2 Network V2 NAS system"
BR2_ROOTFS_DEVICE_CREATION_DYNAMIC_MDEV=y
BR2_ROOTFS_MERGED_USR=y
BR2_TARGET_GENERIC_ROOT_PASSWD="root"
BR2_SYSTEM_DHCP="eth0"
BR2_TARGET_TZ_INFO=y
BR2_TARGET_LOCALTIME="Europe/Amsterdam"
BR2_ROOTFS_OVERLAY="$(BR2_EXTERNAL)/d2netv2/rootfs_overlay"
BR2_LINUX_KERNEL=y
BR2_LINUX_KERNEL_USE_CUSTOM_CONFIG=y
BR2_LINUX_KERNEL_CUSTOM_CONFIG_FILE="$(BR2_EXTERNAL)/d2netv2/linux.config"
BR2_LINUX_KERNEL_UIMAGE_LOADADDR="2000000"
BR2_LINUX_KERNEL_DTS_SUPPORT=y
BR2_LINUX_KERNEL_INTREE_DTS_NAME="kirkwood-d2net"
BR2_PACKAGE_PV=y
BR2_PACKAGE_GIT=y
BR2_PACKAGE_TREE=y
BR2_PACKAGE_DOSFSTOOLS=y
BR2_PACKAGE_DOSFSTOOLS_MKFS_FAT=y
BR2_PACKAGE_EXFAT=y
BR2_PACKAGE_NFS_UTILS=y
BR2_PACKAGE_PARTED=y
BR2_PACKAGE_SMARTMONTOOLS=y
BR2_PACKAGE_SYSSTAT=y
BR2_PACKAGE_UBOOT_TOOLS=y
BR2_PACKAGE_NODEJS=y
BR2_PACKAGE_NODEJS_NPM=y
BR2_PACKAGE_PHP=y
BR2_PACKAGE_PHP_EXT_READLINE=y
BR2_PACKAGE_PHP_EXT_ZIP=y
BR2_PACKAGE_PHP_EXT_JSON=y
BR2_PACKAGE_PHP_EXT_CURL=y
BR2_PACKAGE_PHP_SAPI_CLI=y
BR2_PACKAGE_LIBSELINUX=y
BR2_PACKAGE_DHCPCD=y
BR2_PACKAGE_DROPBEAR=y
BR2_PACKAGE_ETHTOOL=y
BR2_PACKAGE_IFTOP=y
BR2_PACKAGE_IPERF=y
BR2_PACKAGE_IPUTILS=y
BR2_PACKAGE_MINIDLNA=y
BR2_PACKAGE_NETATALK=y
BR2_PACKAGE_NETPLUG=y
BR2_PACKAGE_OPENVPN=y
BR2_PACKAGE_OPENVPN_SMALL=y
BR2_PACKAGE_RSYNC=y
BR2_PACKAGE_TRANSMISSION=y
BR2_PACKAGE_TRANSMISSION_UTP=y
BR2_PACKAGE_TRANSMISSION_CLI=y
BR2_PACKAGE_TRANSMISSION_DAEMON=y
BR2_PACKAGE_TRANSMISSION_REMOTE=y
BR2_PACKAGE_CPULOAD=y
BR2_PACKAGE_FTOP=y
BR2_PACKAGE_HTOP=y
BR2_PACKAGE_NANO=y
BR2_TARGET_ROOTFS_TAR_GZIP=y
```
